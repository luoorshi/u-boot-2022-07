## u-boot-2022.07/configs/quark-luoorshi-h3_defconfig
```kconfig
CONFIG_ARM=y
CONFIG_ARCH_SUNXI=y
CONFIG_DEFAULT_DEVICE_TREE="sun8i-h3-quark-luoorshi"
CONFIG_SPL=y
CONFIG_MACH_SUN8I_H3=y
CONFIG_DRAM_CLK=672
# CONFIG_DRAM_ODT_EN is not set
CONFIG_MMC0_CD_PIN="PH13"
CONFIG_MMC_SUNXI_SLOT_EXTRA=2
# CONFIG_SYS_MALLOC_CLEAR_ON_INIT is not set
# CONFIG_SUN8I_EMAC is not set
# CONFIG_USB_EHCI_HCD is not set
# CONFIG_USB_OHCI_HCD is not set
CONFIG_DM_VIDEO=y
CONFIG_VIDEO_LOGO=y
CONFIG_VIDEO_BPP16=y
# CONFIG_VIDEO_DE2 is not set
CONFIG_SPI=y
CONFIG_DM_SPI=y
CONFIG_DM_GPIO=y
CONFIG_VIDEO_ST7789V=y
CONFIG_VIDEO_ST7789V_SUNXI_H3=y
CONFIG_CONSOLE_ROTATION=y
CONFIG_VIDEO_LOGO_NAME="Quark"
# Disable console output on video screen (only serial output)
CONFIG_SUNXI_CONSOLE_NO_VIDCONSOLE=y
```
